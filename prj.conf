## CMakeLists.txt
```
cmake_minimum_required(VERSION 3.20.0)
find_package(Zephyr REQUIRED HINTS $ENV{ZEPHYR_BASE})
project(uart_token_ring)

target_include_directories(app PRIVATE subsys/token_management/include)
target_sources(app PRIVATE src/main.c subsys/token_management/src/token_manager.c)
```

## prj.conf
```kconfig
# Disable console and shell to free the UART for our own use
CONFIG_CONSOLE=n
CONFIG_UART_CONSOLE=n
CONFIG_SHELL=n

# Enable asynchronous UART support
CONFIG_UART_ASYNC_API=y

# Enable serial support
CONFIG_SERIAL=y

# Use RTT for logging output instead of console
CONFIG_LOG=y
CONFIG_USE_SEGGER_RTT=y
CONFIG_LOG_BACKEND_RTT=y
CONFIG_LOG_DEFAULT_LEVEL=3
```

## boards/arm/nrf52840dk_nrf52840.overlay
```dts
&uart1 {
    status = "okay";
};
```

## src/main.c
```c
#include <zephyr/kernel.h>
#include <zephyr/device.h>
#include <zephyr/devicetree.h>
#include <zephyr/drivers/uart.h>
#include <zephyr/logging/log.h>
#include "token_manager.h"

LOG_MODULE_REGISTER(main, LOG_LEVEL_INF);

static const struct device *uart_dev;

static void frame_handler(const uint8_t *frame, size_t len)
{
    if (len == 1 && frame[0] == 0xAA) {
        LOG_INF("Received Token Frame");
    } else if (frame[0] == 0xBB) {
        LOG_INF("Received Data Frame len=%d", frame[1]);
        // Print payload as well
        size_t payload_len = frame[1];
        if (payload_len > 0) {
            LOG_INF("Payload: %.*s", payload_len, (char *)&frame[2]);
        }
    }
}

static void uart_cb(const struct device *dev, struct uart_event *evt, void *user_data)
{
    switch (evt->type) {
    case UART_RX_RDY:
        // Feed received data to token manager
        token_manager_feed_data(evt->data.rx.buf + evt->data.rx.offset, evt->data.rx.len);
        break;
    case UART_RX_BUF_REQUEST:
        // Provide new buffer if needed, same logic as before
        // (not shown here for brevity, assume you have the double-buffer setup)
        break;
    // Handle other events as before
    default:
        break;
    }
}

void main(void)
{
    uart_dev = DEVICE_DT_GET(DT_NODELABEL(uart0));
    if (!device_is_ready(uart_dev)) {
        LOG_ERR("UART device not ready");
        return;
    }

    // Initialize token manager
    token_manager_init(frame_handler);

    // Set UART callback and enable RX as before
    // ...

    LOG_INF("Ready to receive frames");
}
```
